# CY8C5868AXI_LP035 register map
File version: 0.1
CY8C58LP
Registers are 8-bit, read-write, no defined reset value unless marked. A register's access mark holds for its fields unless they carry their own. Offsets are from the block's base; lines under a group give offsets from that group; [hi:lo] are bit positions; {n}, {i} and the like mark numbered series; 'fields as' and 'values as' point back to an identical list; <NAME> marks a mode.

## Memory map
0x4000647A TFTSHIELD_1_CR_1 size 0x1

## TFTSHIELD_1_CR_1
Base 0x4000647A
0x00 TFTSHIELD_1_CR_1_CONTROL_REG
